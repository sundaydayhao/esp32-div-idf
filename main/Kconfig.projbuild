## main/Kconfig.projbuild
```kconfig
menu "ESP32-DIV Board Configuration"

choice ESP32_DIV_BOARD
    prompt "Select target board"
    default ESP32_DIV_BOARD_V2 if IDF_TARGET_ESP32S3
    default ESP32_DIV_BOARD_V1 if IDF_TARGET_ESP32
    help
        Pick the physical board wiring profile used by this build.

    config ESP32_DIV_BOARD_CYD
        bool "CYD ESP32-2432S028R"
        depends on IDF_TARGET_ESP32

    config ESP32_DIV_BOARD_V1
        bool "ESP32-DIV V1"
        depends on IDF_TARGET_ESP32

    config ESP32_DIV_BOARD_V2
        bool "ESP32-DIV V2"
        depends on IDF_TARGET_ESP32S3
endchoice

config ESP32_DIV_TFT_PANEL_ILI9341
    bool "ILI9341"
    default y
    depends on ESP32_DIV_BOARD_CYD || ESP32_DIV_BOARD_V1 || ESP32_DIV_BOARD_V2
    help
        Supported ESP32-DIV board profiles use ILI9341.

config ESP32_DIV_PCF8574_ENABLED
    bool "Enable PCF8574 button expander"
    default y if ESP32_DIV_BOARD_V1 || ESP32_DIV_BOARD_V2
    default n if ESP32_DIV_BOARD_CYD
    help
        Disable this if your board has no PCF8574 button expander.

config ESP32_DIV_PCF8574_ADDR
    hex "PCF8574 I2C address"
    default 0x20
    help
        I2C address used for the PCF8574 button expander.

config ESP32_DIV_TOUCH_BUTTON_CUE_ENABLED
    int "Show on-screen touch nav bar"
    default 1
    range 0 1
    help
        Set to 0 to hide the footer touch navigation bar.

config ESP32_DIV_PN532_CS
    int "External PN532 chip-select GPIO"
    default 4 if ESP32_DIV_BOARD_V2
    default 17 if ESP32_DIV_BOARD_V1
    default 27
    range 0 48
    help
        External PN532 uses the SD SPI bus. Disconnect any shield radio
        sharing this chip-select before using NFC.

config ESP32_DIV_BUZZER_PIN
    int "Buzzer GPIO"
    default -1
    range -1 48
    help
        GPIO2 is also the V2 battery ADC. Keep disabled for battery sensing.

config ESP32_DIV_BUZZER_USE_PWM
    bool "Use PWM for buzzer"
    default n
    help
        Disable PWM for active buzzers that only need a digital output.

config ESP32_DIV_BUZZER_ACTIVE_LEVEL
    int "Buzzer active level"
    default 1
    range 0 1
    help
        GPIO level that makes the buzzer sound.

config ESP32_DIV_TFT_ROTATION
    int "TFT rotation"
    default 2 if ESP32_DIV_BOARD_V2
    default 0
    range 0 3
    help
        Rotation applied to both TFT and touch input.

config ESP32_DIV_UI_SELF_TEST
    bool "Build UI self-test harness"
    default n
    help
        Build the isolated UI traversal harness used for hardware debug.

config ESP32_DIV_UI_SELF_TEST_AUTO_RUN
    bool "Auto-run UI self-test after boot"
    depends on ESP32_DIV_UI_SELF_TEST
    default n
    help
        Start the UI traversal harness once, four seconds after boot.

endmenu
```

## sdkconfig.defaults
```kconfig
CONFIG_ESPTOOLPY_FLASHMODE_DIO=y
CONFIG_ESPTOOLPY_FLASHFREQ_40M=y
CONFIG_ESPTOOLPY_FLASHSIZE_16MB=y
CONFIG_PARTITION_TABLE_CUSTOM=y
CONFIG_PARTITION_TABLE_CUSTOM_FILENAME="partitions.csv"
CONFIG_COMPILER_OPTIMIZATION_SIZE=y
CONFIG_FREERTOS_HZ=1000
CONFIG_ESP_MAIN_TASK_STACK_SIZE=32768
CONFIG_BT_ENABLED=y
CONFIG_BT_NIMBLE_ENABLED=y
CONFIG_BT_NIMBLE_ROLE_CENTRAL=y
CONFIG_BT_NIMBLE_ROLE_PERIPHERAL=y
CONFIG_BT_NIMBLE_ROLE_BROADCASTER=y
CONFIG_BT_NIMBLE_ROLE_OBSERVER=y
CONFIG_BT_NIMBLE_GATT_CLIENT=y
CONFIG_BT_NIMBLE_GATT_SERVER=y
CONFIG_BT_NIMBLE_SECURITY_ENABLE=y
CONFIG_MBEDTLS_CERTIFICATE_BUNDLE=y
CONFIG_FATFS_LFN_HEAP=y
CONFIG_FATFS_MAX_LFN=255
CONFIG_FATFS_FS_LOCK=8
CONFIG_ESP_CONSOLE_UART_DEFAULT=y
CONFIG_ESPTOOLPY_MONITOR_BAUD=115200
CONFIG_XPT2046_CONVERT_ADC_TO_COORDS=n

CONFIG_BOOTLOADER_APP_ROLLBACK_ENABLE=y
```

## sdkconfig.defaults.v2
```kconfig
CONFIG_ESP32_DIV_BOARD_V2=y
CONFIG_ESPTOOLPY_FLASHSIZE_16MB=y
CONFIG_PARTITION_TABLE_CUSTOM_FILENAME="partitions.csv"
```
